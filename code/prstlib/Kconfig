## code/prstlib/Kconfig
```kconfig
module = PRSTLIB
module-str = prstlib
source "subsys/logging/Kconfig.template.log_config"

config PRSTLIB_BATT_VOLTAGE_DIVIDER
	int "Battery ADC voltage divider ratio"
	default 1
	help
	  Multiplier applied to the battery ADC reading to recover the true
	  battery voltage. Set to 5 when the battery channel samples
	  NRF_SAADC_VDDHDIV5 (i.e. when the board runs in high-voltage mode
	  with VDD regulated below VDDH). Leave at 1 when the channel samples
	  NRF_SAADC_VDD directly.

menu "Soil moisture calibration (regulated VDD only)"

config PRSTLIB_SOIL_DRY_RAW
	int "Raw ADC reading at dry endpoint (sensor in air)"
	default 510
	help
	  Raw 10-bit SAADC reading expected with the sensor in air. Measured
	  on-bench at the regulated VDD: flash a --dev build, observe the
	  raw value in the LOG_DBG output with the sensor untouched. Only
	  consulted when REGOUT0 regulates VDD; on default-REGOUT0 builds
	  the legacy polynomial fit from soil_calibration_coeffs (DT) is
	  used instead.

config PRSTLIB_SOIL_WET_RAW
	int "Raw ADC reading at wet endpoint (sensor in water)"
	default 179
	help
	  Raw 10-bit SAADC reading expected with the sensor submerged in
	  tap water. See PRSTLIB_SOIL_DRY_RAW for measurement procedure.

endmenu

config PRSTLIB_DEV_FAST_LOOP
	bool "Use the bring-up wake cadence instead of the production default"
	default n
	help
	  Single shared knob that the dev snippet flips on. Each sample's
	  Kconfig consults this to pick a shorter sleep duration (e.g. 5 s
	  for ble, 10 s for zigbee) so bench iteration is fast without
	  needing per-sample overrides on the command line. Leave off for
	  battery deployment.

menu "Phototransistor calibration"

config PRSTLIB_PHOTO_LUX_SUN
	int "Reference lux value for current_sun calibration point"
	default 10000
	help
	  Illuminance (in lux) at which PRSTLIB_PHOTO_CURRENT_SUN_UA of
	  photocurrent is expected. Calibration is linear from there:
	  brightness_lux = (V_adc / R_output) * lux_sun / current_sun.

config PRSTLIB_PHOTO_CURRENT_SUN_UA
	int "Photocurrent at PRSTLIB_PHOTO_LUX_SUN, in microamps"
	default 3546
	help
	  With the 470 Ω output resistor, 3546 µA at 10000 lux yields the
	  measured response of 6 lux per mV of ADC voltage (e.g. 400 mV ->
	  2400 lux). Recalibrate when VDD or the output resistor changes —
	  the photocurrent at the same illuminance scales with the drive
	  voltage.

endmenu
```

## code/prstlib/boards/bparasite/Kconfig.bparasite
```kconfig
config BOARD_BPARASITE
	select SOC_NRF52833_QIAA if BOARD_BPARASITE_NRF52833
	select SOC_NRF52840_QIAA if BOARD_BPARASITE_NRF52840

rsource "Kconfig.regout0"
```

## code/prstlib/boards/bparasite/Kconfig.defconfig
```kconfig
if BOARD_BPARASITE

config BOARD
	default "bparasite"

config BOARD_REVISION
	string "Board revision."
	default "1.0.0"

config BOARD_REVISION_CODE
	int "Board revision code. An integer representation of the board revision."
	default 1

# board_regout0.c programs UICR.REGOUT0 for every choice — including 1V8,
# which is written explicitly rather than left at the chip's factory value.
# VDD is therefore always regulated below VDDH, so the battery channel
# samples VDDH/5 (see bparasite_nrf52840_2_0_0_ry1.overlay) and the firmware
# must scale the reading back up by 5.
config PRSTLIB_BATT_VOLTAGE_DIVIDER
	default 5 if BOARD_BPARASITE_NRF52840

# board_regout0.c calls nrfx_nvmc_uicr_erase()/_bytes_write(). Pull the nrfx
# NVMC driver into the build so those symbols actually link.
config NRFX_NVMC
	default y if BOARD_BPARASITE_NRF52840

# Single source of truth for radio TX power across BLE + 802.15.4. The
# regulated VDD is the constraint: +8 dBm needs VDD ≳ 2.7 V under TX
# peaks; +4 dBm needs ≳ 2.4 V; otherwise the radio browns out. BLE picks
# its choice symbol from this int, and zigbee passes it straight to
# zb_trans_set_tx_power().
config PRSTLIB_RADIO_TX_PWR_DBM
	int
	default 0 if BPARASITE_REGOUT0_1V8 || BPARASITE_REGOUT0_2V1
	default 4 if BPARASITE_REGOUT0_2V4 || BPARASITE_REGOUT0_2V7
	default 8 if BPARASITE_REGOUT0_3V0 || BPARASITE_REGOUT0_3V3
	depends on BOARD_BPARASITE_NRF52840

if BT && BOARD_BPARASITE_NRF52840

choice BT_CTLR_TX_PWR
	default BT_CTLR_TX_PWR_0      if PRSTLIB_RADIO_TX_PWR_DBM = 0
	default BT_CTLR_TX_PWR_PLUS_4 if PRSTLIB_RADIO_TX_PWR_DBM = 4
	default BT_CTLR_TX_PWR_PLUS_8 if PRSTLIB_RADIO_TX_PWR_DBM = 8
endchoice

endif # BT && BOARD_BPARASITE_NRF52840

endif  # BOARD_BPARASITE
```

## code/prstlib/boards/bparasite/Kconfig.regout0
```kconfig
# UICR.REGOUT0 voltage selection for nRF52840 high-voltage mode.
# board.c reads this choice at boot and programs UICR if needed.

choice
	prompt "REGOUT0 voltage (VDD when high-voltage mode is active)"
	default BPARASITE_REGOUT0_2V1
	depends on BOARD_BPARASITE_NRF52840
	help
	  Selects the regulated VDD output when the chip is in high-voltage
	  mode (VDDH is the supply, e.g. CR2032 on VDDH). board.c writes
	  UICR.REGOUT0 on first boot, or re-programs it (full UICR snapshot
	  + erase + restore) when the build choice changes. Has no effect
	  when the chip is in normal-voltage mode (VDD tied directly to the
	  supply).

config BPARASITE_REGOUT0_1V8
	bool "1.8 V — longest CR2032 life, LED won't light"
	help
	  Programs UICR.REGOUT0 to the 1.8 V setting explicitly. The chip's
	  factory value happens to be 1.8 V too, but it's encoded as a
	  distinct "default" field value, so a virgin chip still takes one
	  UICR erase + write + reset on first boot.

config BPARASITE_REGOUT0_2V1
	bool "2.1 V — best CR2032 life, red LED OK at Vf ≈ 1.85 V"

config BPARASITE_REGOUT0_2V4
	bool "2.4 V — balanced, BLE up to +4 dBm"

config BPARASITE_REGOUT0_2V7
	bool "2.7 V — BLE +4 dBm with headroom"

config BPARASITE_REGOUT0_3V0
	bool "3.0 V — only with USB / boosted VDDH"

config BPARASITE_REGOUT0_3V3
	bool "3.3 V — only with USB / boosted VDDH"

endchoice
```

## code/prstlib/west.yml
```yaml
manifest:
  remotes:
    - name: nrfconnect
      url-base: https://github.com/nrfconnect
  projects:
    # - name: nrf
    #   repo-path: sdk-nrf
    #   remote: nrfconnect
    #   revision: v3.3.0
    #   import: true
    # ncs-zigbee @ 15854504b47cb8c84f4f07ddc716c9d77e4b9238 transitively imports sdk-nrf v3.3.0.
    # https://github.com/nrfconnect/ncs-zigbee/blob/15854504b47cb8c84f4f07ddc716c9d77e4b9238/west.yml#L13
    # TODO: use groups to avoid importing the whole ncs-zigbee for every sample build.
    - name: ncs-zigbee
      remote: nrfconnect
      revision: 15854504b47cb8c84f4f07ddc716c9d77e4b9238
      import: true
  self:
    path: prstlib
```
