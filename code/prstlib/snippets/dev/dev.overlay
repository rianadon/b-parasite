/*
 * Shared bring-up DT overlay for b-parasite samples. Pairs with dev.conf.
 * Routes Zephyr's console to a USB CDC ACM virtual UART on the nRF52840's
 * native USB device controller so the host sees logs over the same USB
 * connection used to flash the board.
 */
&usbd {
	status = "okay";
	cdc_acm_uart0: cdc_acm_uart0 {
		compatible = "zephyr,cdc-acm-uart";
	};
};

/ {
	chosen {
		zephyr,console = &cdc_acm_uart0;
		zephyr,shell-uart = &cdc_acm_uart0;
	};
};
