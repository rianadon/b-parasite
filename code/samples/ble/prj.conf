## CMakeLists.txt
```
cmake_minimum_required(VERSION 3.20.0)
find_package(Zephyr REQUIRED HINTS $ENV{ZEPHYR_BASE})
project(ble)

include_directories(src)

target_sources(app PRIVATE
	src/main.c
	src/ble.c
	src/encoding.c
)
```

## Kconfig
```
source "Kconfig.zephyr"

config PRST_SLEEP_DURATION_MSEC
	int "Sleep duration in milliseconds"
	default 5000 if PRSTLIB_DEV_FAST_LOOP
	default 600000

config PRST_BLE_ADV_DURATION_MSEC
	int "Advertising duration in milliseconds"
	default 1000

config PRST_BLE_MIN_ADV_INTERVAL
	int "Minimum advertising interval in milliseconds"
	default 30

config PRST_BLE_MAX_ADV_INTERVAL
	int "Maximum advertising interval in milliseconds"
	default 40

choice PRST_BLE_ENCODING
	prompt "b-parasite BLE encoding"
	default PRST_BLE_ENCODING_BTHOME_V2

config PRST_BLE_ENCODING_BPARASITE_V2
	bool "Uses the custom b-parasite protocol v2 for encoding advertising packets"

config PRST_BLE_ENCODING_BTHOME_V1
	bool "Uses the BTHome (bthome.io) BLE encoding (v1)"

config PRST_BLE_ENCODING_BTHOME_V2
	bool "Uses the BTHome (bthome.io) BLE encoding (v2)"

endchoice  # PRST_BLE_ENCODING

config PRST_BLE_ENCODING_SERVICE_DATA_LEN
	int
	help
		Size of the service data buffer.
	default 20 if PRST_BLE_ENCODING_BPARASITE_V2
	default 18 if PRST_BLE_ENCODING_BTHOME_V1
	default 19 if PRST_BLE_ENCODING_BTHOME_V2


config PRST_BLE_HAS_USER_DEFINED_RANDOM_STATIC_ADDR
	bool "Whether to use a custom BLE address"

config PRST_BLE_USER_DEFINED_RANDOM_STATIC_ADDR
	string "Overrides the device's BT address"
	help
		This address has to be random static (e.g.: f0:ca:f0:ca:01:d5).
	depends on PRST_BLE_HAS_USER_DEFINED_RANDOM_STATIC_ADDR
```

## prj.conf
```kconfig
CONFIG_LOG=y
CONFIG_PWM=y
CONFIG_CBPRINTF_FP_SUPPORT=y
CONFIG_I2C=y
CONFIG_ADC=y
CONFIG_GPIO=y

CONFIG_BT=y
CONFIG_BT_PERIPHERAL=y
CONFIG_BT_DEVICE_NAME="prst"
# TX power is selected by the board defconfig based on REGOUT0 voltage.
# Override here only if you need a specific level (e.g. for range testing):
# CONFIG_BT_CTLR_TX_PWR_PLUS_8=y

CONFIG_SERIAL=n

CONFIG_NEWLIB_LIBC=y
CONFIG_NEWLIB_LIBC_FLOAT_PRINTF=y

CONFIG_ASSERT=y
```

## dev.conf
```kconfig
# Development overlay for the ble sample.
#
# Applied on top of prj.conf by `scripts/build.sh ble … --dev`.
# Wires up USB CDC ACM as the console so you can watch the per-sensor
# debug log over the same USB connection that flashed the board, and
# shrinks the wake cadence so `prst` advertises every few seconds for
# easy scanning. Not appropriate for battery deployment — the USB stack
# and the tight loop wreck battery life.

# USB CDC ACM console (paired with dev.overlay).
CONFIG_SERIAL=y
CONFIG_CONSOLE=y
CONFIG_UART_CONSOLE=y
CONFIG_USB_DEVICE_STACK=y
CONFIG_USB_DEVICE_PRODUCT="b-parasite ble (dev)"
CONFIG_USB_DEVICE_INITIALIZE_AT_BOOT=y
CONFIG_USB_CDC_ACM=y
CONFIG_UART_LINE_CTRL=y

# Wake every ~6 s — sensor read + 1 s adv + 5 s sleep. Easy to scan in
# nRF Connect, slow enough that battery life is still measured in days
# if you actually power from a cell.
CONFIG_PRST_SLEEP_DURATION_MSEC=5000
CONFIG_PRST_BLE_ADV_DURATION_MSEC=1000

# Per-sensor DBG lines from prstlib.
CONFIG_PRSTLIB_LOG_LEVEL_DBG=y
```

## app.overlay
```dts
/*
 * Route Zephyr's console to a USB CDC ACM virtual UART so we can see which
 * sensor read (or BLE init step) is failing on a board with no UART pads.
 */
&usbd {
	status = "okay";
	cdc_acm_uart0: cdc_acm_uart0 {
		compatible = "zephyr,cdc-acm-uart";
	};
};

/ {
	chosen {
		zephyr,console = &cdc_acm_uart0;
		zephyr,shell-uart = &cdc_acm_uart0;
	};
};
```

## src/encoding.c
```c
#include "encoding.h"

#include <prstlib/macros.h>
#include <zephyr/logging/log.h>

LOG_MODULE_DECLARE(ble, LOG_LEVEL_INF);

int prst_ble_encode_service_data(const prst_sensors_t* sensors,
                                 const bt_addr_le_t* bt_addr, uint8_t* out,
                                 uint8_t out_len) {
  RET_CHECK(out_len >= CONFIG_PRST_BLE_ENCODING_SERVICE_DATA_LEN,
            "Buffer is not large enough");

#if CONFIG_PRST_BLE_ENCODING_BPARASITE_V2
  // 0x181a - Environmental sensing service UUID.
  out[0] = 0x1a;
  out[1] = 0x18;
  // Four bits for the protocol version.
  out[2] |= (2 << 4) & 0xf0;
  // Bit 0 of byte 0 specifies whether or not ambient light data exists in the
  // payload.
#if DT_NODE_EXISTS(DT_NODELABEL(photo_transistor)) || DT_NODE_EXISTS(DT_NODELABEL(ldr))
  out[2] |= 1;
#endif
  // 4 bits for a small wrap-around counter for deduplicating messages on the
  // receiver.

  static uint8_t run_counter;

  out[3] = run_counter++ & 0x0f;
  out[4] = sensors->batt.adc_read.millivolts >> 8;
  out[5] = sensors->batt.adc_read.millivolts & 0xff;
  int16_t temp_centicelsius = 100 * sensors->shtc3.temp_c;
  out[6] = temp_centicelsius >> 8;
  out[7] = temp_centicelsius & 0xff;
  uint16_t humi = sensors->shtc3.rel_humi * UINT16_MAX;
  out[8] = humi >> 8;
  out[9] = humi & 0xff;
  uint16_t soil_moisture = sensors->soil.percentage * UINT16_MAX;
  out[10] = soil_moisture >> 8;
  out[11] = soil_moisture & 0xff;
  // MAC address in big-endian.
  memcpy(out + 12, bt_addr->a.val, BT_ADDR_SIZE);
  out[18] = sensors->photo.brightness >> 8;
  out[19] = sensors->photo.brightness & 0xff;

// https://bthome.io/v1/
#elif CONFIG_PRST_BLE_ENCODING_BTHOME_V1

  // 0x181c - User data service UUID.
  out[0] = 0x1c;
  out[1] = 0x18;

  // 1. Soil moisture.
  // uint16_t.
  out[2] = (0b000 << 5) | 3;
  // Type of measurement - Moisture.
  out[3] = 0x14;
  // Value. Factor of 0.01, so we need to multiply our the value in 100% by
  // 1/0.01 = 100.
  uint16_t soil_val = 10000 * sensors->soil.percentage;
  out[4] = soil_val & 0xff;
  out[5] = soil_val >> 8;
  // 2. Temp.
  // int16_t.
  out[6] = (0b001 << 5) | 3;
  // Type of measurement - temperature.
  out[7] = 0x02;
  // Value. Factor 0.01.
  int16_t temp_val = 100 * sensors->shtc3.temp_c;
  out[8] = temp_val & 0xff;
  out[9] = temp_val >> 8;
  // 3. Humidity
  // uint16_t.
  out[10] = (0b000 << 5) | 3;
  // Type - humidity.
  out[11] = 0x03;
  // Value. Factor 0.01, over 100%.
  uint16_t humi_val = 10000 * sensors->shtc3.rel_humi;
  out[12] = humi_val & 0xff;
  out[13] = humi_val >> 8;
  // 4. Battery voltage.
  // uint16_t.
  out[14] = (0b000 << 5) | 3;
  // Type - voltage.
  out[15] = 0x0c;
  // Value. Factor of 0.001.
  uint16_t batt_val = sensors->batt.adc_read.millivolts;
  out[16] = batt_val & 0xff;
  out[17] = batt_val >> 8;

// https://bthome.io/format/
#elif CONFIG_PRST_BLE_ENCODING_BTHOME_V2
  // 0xfcd2 - bthome.io service UUID.
  out[0] = 0xd2;
  out[1] = 0xfc;

  // Service header - no encryption, bt home v2.
  out[2] = 0x40;

  // Battery percentage.
  out[3] = 0x01;
  // Value. Factor 1 over 100%
  uint8_t batt_percentage_val = 100 * sensors->batt.percentage + 0.5f;
  out[4] = batt_percentage_val;

  // Temperature.
  out[5] = 0x02;
  int16_t temp_val = 100 * sensors->shtc3.temp_c;
  out[6] = temp_val & 0xff;
  out[7] = temp_val >> 8;

  // Illuminance.
  out[8] = 0x05;
  // Value. Factor of 0.01.
  uint32_t lux_val = sensors->photo.brightness * 100;
  out[9] = lux_val & 0xff;
  out[10] = (lux_val >> 8) & 0xff;
  out[11] = (lux_val >> 16) & 0xff;

  // Battery voltage.
  out[12] = 0x0c;
  // Value. Factor of 0.001.
  uint16_t batt_val = sensors->batt.adc_read.millivolts;
  out[13] = batt_val & 0xff;
  out[14] = batt_val >> 8;

  // Humidity.
  out[15] = 0x2E;
  // Value. Factor 1 over 100%.
  uint8_t humi_val = 100 * sensors->shtc3.rel_humi + 0.5f;
  out[16] = humi_val;

  // Soil moisture.
  out[17] = 0x2F;
  // Factor of 1 over 100%
  uint8_t soil_val = 100 * sensors->soil.percentage + 0.5f;
  out[18] = soil_val;

#endif  // Encoding protocols

  LOG_HEXDUMP_DBG(out, out_len, "Encoded BLE adv: ");
  return 0;
}
```
