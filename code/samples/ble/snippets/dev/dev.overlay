/*
 * Development overlay for ble sample. Pairs with dev.conf.
 * Routes Zephyr's console to a USB CDC ACM virtual UART so the host
 * sees per-sensor debug logs over the flashing USB connection.
 */
&usbd {
	status = "okay";
	cdc_acm_uart0: cdc_acm_uart0 {
		compatible = "zephyr,cdc-acm-uart";
	};
};

/ {
	chosen {
		zephyr,console = &cdc_acm_uart0;
		zephyr,shell-uart = &cdc_acm_uart0;
	};
};
